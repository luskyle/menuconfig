## test/kconfig
```kconfig
mainmenu "leetide GUI configuration"

choice
    prompt	"select render library"
    default 	RENDER_LIB_X11
	help
		不指定，直接编译

    config 	RENDER_LIB_LVGL
		bool "LVGL library"
		help
			不指定，直接编译

    config 	RENDER_LIB_X11
		bool "linux x11 library"
		help
			不指定，直接编译
endchoice
```
